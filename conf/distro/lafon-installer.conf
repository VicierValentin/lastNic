## conf/distro/lafon-installer.conf
```bitbake
#
#   Copyright (C) 2019
#   SPDX-License-Identifier: MIT
#

require conf/distro/poky.conf

MAINTAINER = "Jocelyn Millard <jocelyn.millard@lafon.fr>"
DISTRO = "lafon-installer"
DISTRO_NAME = "Lafon Technologies Linux"
DISTRO_VERSION = "3.0"
TARGET_VENDOR = "-lafon"

# Remove unused features
MACHINE_FEATURES:remove = " \
	apm \
	alsa \
	rtc \
"

# Add distro features
#DISTRO_FEATURES:append = " "

# Remove unused features
DISTRO_FEATURES:remove = " \
	bluetooth \
"

#Enable systemd
DISTRO_FEATURES:append = " systemd "
DISTRO_FEATURES_BACKFILL_CONSIDERED = "sysvinit"
VIRTUAL-RUNTIME_init_manager = "systemd"
VIRTUAL-RUNTIME_initscripts = ""

# Needed for SWUpdate
IMAGE_FSTYPES += " ext4.gz tar.gz"
# 
IMAGE_FSTYPES:remove = "jffs2"

PREFERRED_PROVIDER_u-boot-fw-utils = "libubootenv"
PREFERRED_VERSION_libubootenv = "0.%"
```

## conf/distro/lafon.conf
```bitbake
#
#   Copyright (C) 2019
#   SPDX-License-Identifier: MIT
#

require conf/distro/poky.conf

MAINTAINER = "Jocelyn Millard <jocelyn.millard@lafon.fr>"
DISTRO = "lafon"
DISTRO_NAME = "Lafon Technologies Linux"
DISTRO_VERSION = "3.0"
TARGET_VENDOR = "-lafon"

# Remove unused features
MACHINE_FEATURES:remove = " \
	apm \
	alsa \
	rtc \
"

# Add distro features
#DISTRO_FEATURES:append = " "

# Remove unused features
DISTRO_FEATURES:remove = " \
	bluetooth \
"

#Enable systemd
DISTRO_FEATURES:append = " systemd "
DISTRO_FEATURES_BACKFILL_CONSIDERED = "sysvinit"
VIRTUAL-RUNTIME_init_manager = "systemd"
VIRTUAL-RUNTIME_initscripts = ""

# Needed for SWUpdate
IMAGE_FSTYPES += " ext4.gz tar.gz"
IMAGE_FSTYPES += "wic wic.bmap"
# 
IMAGE_FSTYPES:remove = "jffs2"

PREFERRED_PROVIDER_u-boot-fw-utils = "libubootenv"
PREFERRED_VERSION_libubootenv = "0.3.%"

# Use systemd as init system
VIRTUAL-RUNTIME_init_manager = "systemd"
DISTRO_FEATURES_BACKFILL_CONSIDERED = "sysvinit"
VIRTUAL-RUNTIME_initscripts = ""
DISTRO_FEATURES:append = " systemd"

# SDK config
SDK_NAME_PREFIX = "${DISTRO}-sdk"
SDK_VENDOR = "-${DISTRO}sdk"
SDKPATH = "/opt/${SDK_NAME_PREFIX}-${SDK_ARCH}/${SDK_VERSION}"
SDK_VERSION = "${DISTRO_VERSION}"
SDKIMAGE_FEATURES:append = " staticdev-pkgs"

IMAGE_INSTALL:append = " psplash"
IMAGE_FEATURES += " splash "
```

## conf/layer.conf
```bitbake
# We have a conf and classes directory, add to BBPATH
BBPATH .= ":${LAYERDIR}"

# We have recipes-* directories, add to BBFILES
BBFILES += "${LAYERDIR}/recipes-*/*/*.bb \
            ${LAYERDIR}/recipes-*/*/*.bbappend"

BBFILE_COLLECTIONS += "meta-magfleet"
BBFILE_PATTERN_meta-magfleet = "^${LAYERDIR}/"
BBFILE_PRIORITY_meta-magfleet = "17"

LAYERDEPENDS_meta-magfleet = "core"
LAYERSERIES_COMPAT_meta-magfleet = "kirkstone"
```

## conf/machine/beaglebone-lafon-installer.conf
```bitbake
#@TYPE: Machine
#@NAME: Beaglebone machine - Lafon Technologies
#@DESCRIPTION: Machine configuration for Lafon Technologies

require conf/machine/beaglebone-yocto.conf

MACHINEOVERRIDES =. "beaglebone-yocto:"

KERNEL_DEVICETREE = "am335x-boneblack.dtb"

KMACHINE = "beaglebone-yocto"

WIC_CREATE_EXTRA_ARGS ?= "--no-fstab-update"

USE_VT = "0"

WKS_FILE = "easybornInstall.wks"
```

## conf/machine/beaglebone-lafon.conf
```bitbake
#@TYPE: Machine
#@NAME: Beaglebone machine - Lafon Technologies
#@DESCRIPTION: Machine configuration for Lafon Technologies

require conf/machine/beaglebone-yocto.conf

MACHINEOVERRIDES =. "beaglebone-yocto:"

KMACHINE = "beaglebone-yocto"

WIC_CREATE_EXTRA_ARGS ?= "--no-fstab-update"

USE_VT = "0"

WKS_FILE = "easyborn.wks"
```

## kas-files/build/conf/bblayers.conf
```bitbake
# standard
POKY_BBLAYERS_CONF_VERSION = "2"
BBPATH = "${TOPDIR}"
BBFILES ?= ""

BBLAYERS ?= " \
    ${TOPDIR}/../.. \
    ${TOPDIR}/../meta-arm/meta-arm \
    ${TOPDIR}/../meta-arm/meta-arm-toolchain \
    ${TOPDIR}/../meta-openembedded/meta-networking \
    ${TOPDIR}/../meta-openembedded/meta-oe \
    ${TOPDIR}/../meta-openembedded/meta-perl \
    ${TOPDIR}/../meta-openembedded/meta-python \
    ${TOPDIR}/../meta-security \
    ${TOPDIR}/../meta-swupdate \
    ${TOPDIR}/../meta-ti/meta-ti-bsp \
    ${TOPDIR}/../meta-ti/meta-ti-extras \
    ${TOPDIR}/../poky/meta \
    ${TOPDIR}/../poky/meta-poky \
    ${TOPDIR}/../poky/meta-yocto-bsp"
BBPATH ?= "${TOPDIR}"
BBFILES ??= ""
```

## kas-files/build/conf/local.conf
```bitbake
# debug-tweaks
EXTRA_IMAGE_FEATURES = "debug-tweaks"

# diskmon
BB_DISKMON_DIRS = "\
    STOPTASKS,${TMPDIR},1G,100K \
    STOPTASKS,${DL_DIR},1G,100K \
    STOPTASKS,${SSTATE_DIR},1G,100K \
    STOPTASKS,/tmp,100M,100K \
    ABORT,${TMPDIR},100M,1K \
    ABORT,${DL_DIR},100M,1K \
    ABORT,${SSTATE_DIR},100M,1K \
    ABORT,/tmp,10M,1K"

# lafon-opt
VAR_BRANCH = "mid"
VAR_BRANCH_BDD = "mid"
VAR_BRANCH_WEB = "main-dev"
VAR_BRANCH_LANG = "main-dev"
VAR_BRANCH_IMG = "main-dev"
VAR_BRANCH_JNRL = "main-dev"
IMAGE_EASY_NAME = "easyborn-lafon-masterdev"
SSTATE_DIR ?= "${TOPDIR}/sstate-cache"
PACKAGECONFIGC:append:pn-qemu-system-native = " sdl"
PACKAGE_CLASSES ?= "package_rpm"

# standard
CONF_VERSION = "2"
USER_CLASSES = "buildstats"
PATCHRESOLVE = "noop"

MACHINE ??= "beaglebone-lafon-installer"
DISTRO ??= "lafon-installer"
BBMULTICONFIG ?= ""
```

## wic/easyborn (MID).wks
```
part /boot --source bootimg-partition --ondisk mmcblk --fstype=vfat --label boot --active --align 4 --size 16 --sourceparams="loader=u-boot" --use-uuid
part / --source rootfs --ondisk mmcblk --fstype=ext4 --label rootfs_A --align 4 --use-uuid 
part / --source rootfs --ondisk mmcblk --fstype=ext4 --label rootfs_B --align 4 --use-uuid 
part /data --ondisk mmcblk --source rootfs --rootfs-dir=${IMAGE_ROOTFS}/data --fstype=ext4 --label data --size 128M --align 8192 --extra-space 0
part /mid_A --ondisk mmcblk --rootfs-dir=${IMAGE_ROOTFS}/mid_A --fstype=ext4 --label mid_A --fixed-size 256M --align 3670016 --extra-space 0
part /mid_B --ondisk mmcblk --rootfs-dir=${IMAGE_ROOTFS}/mid_B --fstype=ext4 --label mid_B --fixed-size 256M --align 3932160 --extra-space 0

bootloader --append="console=ttyS0,115200 rw"
```

## wic/easyborn.wks
```
part /boot --source bootimg-partition --ondisk mmcblk --fstype=vfat --label boot --active --align 4 --size 100M --sourceparams="loader=u-boot" --use-uuid
part / --source rootfs --ondisk mmcblk --fstype=ext4 --label rootfs_A --align 4 --use-uuid 
part / --source rootfs --ondisk mmcblk --fstype=ext4 --label rootfs_B --align 4 --use-uuid 
part /transac --ondisk mmcblk --fstype=ext4 --label transac --size 1G  --align 1024
part /data --ondisk mmcblk --source rootfs --rootfs-dir=${IMAGE_ROOTFS}/data --fstype=ext4 --label data --size 512M --align 8192 --extra-space 0

bootloader --append="console=ttyS0,115200 rw"
```

## wic/easybornInstall.wks
```
part /boot --source bootimg-partition --ondisk mmcblk --fstype=vfat --label boot --active --align 4 --size 16 --sourceparams="loader=u-boot" --use-uuid
part / --source rootfs --ondisk mmcblk --fstype=ext4 --label rootfs_A --align 4 --use-uuid --extra-space 1536

bootloader --append="console=ttyS0,115200 rw"
```
